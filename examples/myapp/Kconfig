## examples/myapp/Kconfig
```kconfig
#
# For a description of the syntax of this configuration file,
# see the file kconfig-language.txt in the NuttX tools repository.
#

config EXAMPLES_MYAPP
	tristate "\"my app!\" example"
	default n
	depends on ADC && BOARDCTL
	---help---
		Enable the \"myapp!\" example

if EXAMPLES_MYAPP

config EXAMPLES_MYAPP_PROGNAME
	string "Program name"
	default "myapp"
	---help---
		This is the name of the program that will be used when the NSH ELF
		program is installed.

config EXAMPLES_MYAPP_PRIORITY
	int "Myapp task priority"
	default 100

config EXAMPLES_MYAPP_STACKSIZE
	int "Myapp stack size"
	default DEFAULT_TASK_STACKSIZE

config EXAMPLES_ADC_DEVPATH
	string "ADC device path"
	default "/dev/adc0"
	---help---
		The default path to the ADC device. Default: /dev/adc0

config EXAMPLES_ADC_NSAMPLES
	int "Number of Sample Groups"
	default 0
	---help---
		This number of samples is collected and the program terminates.
		Default:  0 (samples are collected indefinitely).

config EXAMPLES_ADC_GROUPSIZE
	int "Number of Samples per Group"
	default 4
	---help---
		The number of samples to read at once. Default: 4

config EXAMPLES_ADC_SWTRIG
	bool "Use software trigger"
	default n
	---help---
		Some ADCs may be configured so there is no automatic or periodic
		conversion of samples.  Rather, the ADC sampling must be trigger by
		software via an ioctl command.  Select this option only if
		applicable for your ADC configuration.  In this case, the test will
		issue the software trigger ioctl before attempting to read from the
		ADC.

endif
```

## examples/volapp/Kconfig
```kconfig
#
# For a description of the syntax of this configuration file,
# see the file kconfig-language.txt in the NuttX tools repository.
#

config EXAMPLES_VOLAPP
	tristate "\"vol app!\" example"
	default n
	depends on ADC && BOARDCTL
	---help---
		Enable the \"volapp!\" example

if EXAMPLES_VOLAPP

config EXAMPLES_VOLAPP_PROGNAME
	string "Program name"
	default "volapp"
	---help---
		This is the name of the program that will be used when the NSH ELF
		program is installed.

config EXAMPLES_VOLAPP_PRIORITY
	int "Myapp task priority"
	default 100

config EXAMPLES_VOLAPP_STACKSIZE
	int "Myapp stack size"
	default DEFAULT_TASK_STACKSIZE

config ADC_DEVPATH
	string "ADC device path"
	default "/dev/adc0"
	---help---
		The default path to the ADC device. Default: /dev/adc0

config ADC_NSAMPLES
	int "Number of Sample Groups"
	default 0
	---help---
		This number of samples is collected and the program terminates.
		Default:  0 (samples are collected indefinitely).

config ADC_GROUPSIZE
	int "Number of Samples per Group"
	default 4
	---help---
		The number of samples to read at once. Default: 4

config ADC_SWTRIG
	bool "Use software trigger"
	default n
	---help---
		Some ADCs may be configured so there is no automatic or periodic
		conversion of samples.  Rather, the ADC sampling must be trigger by
		software via an ioctl command.  Select this option only if
		applicable for your ADC configuration.  In this case, the test will
		issue the software trigger ioctl before attempting to read from the
		ADC.

config STM32L4_ADC1_SAMPLE_FREQUENCY
	int "ADC1 Sampling Frequency"
	default 100
	depends on STM32L4_HAVE_ADC1_TIMER
	---help---
		ADC1 sampling frequency.  Default:  100Hz
		
endif
```
